## board/ky/x1/Kconfig
```kconfig
if TARGET_KY_X1

config SYS_BOARD
	default "x1"

config SYS_VENDOR
	default "ky"

config SYS_CPU
	default "x60"

config SYS_CONFIG_NAME
	default "x1"

config SYS_TEXT_BASE
	default 0x81200000 if SPL
	default 0x80000000 if !RISCV_SMODE
	default 0x80200000 if RISCV_SMODE && ARCH_RV64I
	default 0x80400000 if RISCV_SMODE && ARCH_RV32I

config SPL_TEXT_BASE
	default 0x20100000

config SPL_OPENSBI_LOAD_ADDR
	hex
	default 0x21000000

config FDT_ADD_MEMORY_NODE
	bool "enable to add memory node to fdt before boot kernel"
	default n

config KY_BUILD_BIN
	bool "build fsbl.bin for ky image"
	default n

config BOARD_SPECIFIC_OPTIONS # dummy
	def_bool y
	select KY_X60
	select FDT_ADD_MEMORY_NODE
	imply AHCI
	imply SMP
	imply BOARD_LATE_INIT
	imply PCI_INIT_R
	imply SPL_RAM_SUPPORT
	imply SPL_RAM_DEVICE
	imply CMD_PCI
	imply CMD_POWEROFF
	imply CMD_SBI
	imply CMD_SCSI
	imply CMD_PING
	imply CMD_EXT2
	imply CMD_EXT4
	imply CMD_FAT
	imply CMD_FS_GENERIC
	imply DOS_PARTITION
	imply ISO_PARTITION
	imply EFI_PARTITION
	imply SCSI_AHCI
	imply AHCI_PCI
	imply E1000
	imply NVME
	imply PCI
	imply PCIE_ECAM_GENERIC
	imply SCSI
	imply DM_SCSI
	imply SYS_NS16550
	imply SIFIVE_SERIAL
	imply HTIF_CONSOLE if 64BIT
	imply SYSRESET
	imply SYSRESET_CMD_POWEROFF
	imply SYSRESET_SYSCON
	imply VIRTIO_MMIO
	imply VIRTIO_PCI
	imply VIRTIO_NET
	imply VIRTIO_BLK
	imply MTD_NOR_FLASH
	imply CFI_FLASH
	imply OF_HAS_PRIOR_STAGE

choice
	prompt "product board"
	default K1_X_BOARD_FPGA

config K1_X_BOARD_FPGA
	bool "x1 board fpga"
	help
	  x1 board is fpga.

config K1_X_BOARD_ASIC
	bool "x1 board asic"
	help
	  x1 board is asic.

config K1_X_BOARD_SIMULATION
	bool "x1 board simulation"
	help
	  x1 board is simulation.

endchoice

config SPL_BOOTING_NON_AI_CORE_SUPPORT
       bool "Support booting non ai core in SPL"
       depends on SPL_OPENSBI && K1_X_BOARD_ASIC
       help
         Support letting the non ai core as the booting cpu and bring it up
         first

endif
```

## board/ky/x1/configs/uboot_fdt.its
```
/dts-v1/;

/ {
	description = "U-boot FIT image for x1";
	#address-cells = <2>;
	fit,fdt-list = "of-list";

	images {
		uboot {
			description = "U-Boot";
			type = "standalone";
			os = "U-Boot";
			arch = "riscv";
			compression = "none";
			load = <0x0 0x00200000>;
			data = /incbin/("../u-boot-nodtb.bin");
			hash-1 {
				algo = "crc32";
			};
		};

		fdt_1 {
			description = "x1_orangepi-rv2";
			type = "flat_dt";
			compression = "none";
			data = /incbin/("../dtb/x1_orangepi-rv2.dtb");
			hash-1 {
				algo = "crc32";
			};
		};
	};

	configurations {
		default = "conf_2";
		conf_1 {
			description = "x1_orangepi-rv2";
			loadables = "uboot";
			fdt = "fdt_1";
		};
	};
};
```

## drivers/clk/ky/Kconfig
```kconfig
# SPDX-License-Identifier: GPL-2.0
# common clock support for KY SoC family.

config KY_K1PRO_CCU
	tristate "Clock support for Ky k1pro SoCs"
	depends on CLK
        depends on CLK_CCF
	help
	  Build the driver for Ky K1pro Clock Driver.

config KY_X1_CCU
        tristate "Clock support for Ky x1 SoCs"
        select CLK
        select CLK_CCF
        help
          Build the driver for Ky K1x Clock Driver.
```

## drivers/net/ky/Kconfig
```kconfig
config KY_X1_EMAC
	bool "Sapcemit x1 Emac Driver"
	depends on DM_ETH
	select PHYLIB
	select DM_RESET
	help
	  This Driver support Ky x1 Ethernet MAC
	  Say Y to enable support for the Ky Ethernet.
```

## drivers/phy/ky/Kconfig
```kconfig
config PHY_KY_X1_USB2
	bool "Ky x1 USB2 PHY Driver"
	depends on PHY
	help
	  Support for Ky x1 USB 2 PHY

config SPL_PHY_KY_X1_USB2
	bool "Ky x1 USB2 PHY Driver in SPL"
	depends on PHY
	help
	  Support for Ky x1 USB 2 PHY

config PHY_KY_X1_COMBPHY
	tristate "Ky K1-x USB3&PCIE combo PHY driver"
	depends on PHY
	help
	  USB3 and PCIE Combo PHY Support for Ky x1 Soc

config SPL_PHY_KY_X1_COMBPHY
	tristate "Ky K1-x USB3&PCIE combo PHY driver in SPL"
	depends on PHY
	help
	  USB3 and PCIE Combo PHY Support for Ky x1 Soc
```

## drivers/pinctrl/ky/Kconfig
```kconfig
config PINCTRL_KY
	bool

config PINCTRL_K1PRO
	bool "Ky K1PRO pinctrl driver"
	depends on TARGET_KY_K1PRO && PINCTRL_FULL
	select DEVRES
	select PINCTRL_KY
	help
	  Say Y here to enable the k1-pro pinctrl driver
```

## drivers/video/ky/Kconfig
```kconfig
# SPDX-License-Identifier: GPL-2.0

menuconfig VIDEO_KY
	bool "Enable KY Video Support"
	depends on DM_VIDEO
	help
	  KY SoCs provide video output capabilities for High-Definition
	  Multimedia Interface (HDMI) and Display Serial Interface (DSI).

	  This driver supports the on-chip video output device.

config VIDEO_KY_MAX_XRES
        int "Maximum horizontal resolution (for memory allocation purposes)"
	depends on VIDEO_KY
	default 1920
	help
	  The maximum horizontal resolution to support for the framebuffer.
	  This configuration is used for reserving/allocating memory for the
	  framebuffer during device-model binding/probing.

config VIDEO_KY_MAX_YRES
        int "Maximum vertical resolution (for memory allocation purposes)"
	depends on VIDEO_KY
	default 1200
	help
	  The maximum vertical resolution to support for the framebuffer.
	  This configuration is used for reserving/allocating memory for the
	  framebuffer during device-model binding/probing.

if VIDEO_KY

config DISPLAY_KY_HDMI
	bool "HDMI port"
	select VIDEO_DW_HDMI
	depends on VIDEO_KY
	help
	  This enables High-Definition Multimedia Interface display support.

config DISPLAY_KY_MIPI
	bool "MIPI Port"
	depends on VIDEO_KY
	help
	  This enables Mobile Industry Processor Interface(MIPI) display
	  support.

config DISPLAY_KY_EDP
	bool "EDP Port"
	depends on DISPLAY_KY_MIPI
	help
	  This enables Mobile Industry Processor Interface(EDP) display
	  support.

endif
```

## uboot-opensbi.its
```
/dts-v1/;

/ {
        description = "U-boot FIT image for x1";
        #address-cells = <2>;
        fit,fdt-list = "of-list";

        images {
                uboot {
                        description = "U-Boot";
                        type = "standalone";
                        os = "U-Boot";
                        arch = "riscv";
                        compression = "none";
                        load = <0x0 0x00200000>;
                        data = /incbin/("./u-boot-nodtb.bin");
                };

                opensbi {
                        description = "OpenSBI fw_dynamic Firmware";
                        type = "firmware";
                        os = "opensbi";
                        arch = "riscv";
                        compression = "none";
                        load = <0x0 0x0>;
                        entry = <0x0 0x0>;
                        data = /incbin/("./fw_dynamic.bin");
                };
                fdt_14 {
                        description = "x1_orangepi-rv2";
                        type = "flat_dt";
                        compression = "none";
                        data = /incbin/("./x1_orangepi-rv2.dtb");
                };
        };

        configurations {
                default = "conf_14";
                conf_14 {
                        description = "x1_orangepi-rv2";
                        firmware = "opensbi";
                        loadables = "uboot";
                        fdt = "fdt_14";
                };
        };
};
```
